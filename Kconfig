## Kconfig
```kconfig
# SPDX-License-Identifier: GPL-2.0-only
# Kconfig - MPU-6050 simplified driver (I2C only, no aux bus)

config IIO_MPU6050_SIMPLE
	tristate "InvenSense MPU-6050 IMU (simplified, I2C only)"
	depends on I2C
	select IIO_BUFFER
	select IIO_TRIGGERED_BUFFER
	help
	  Say Y here to enable a simplified driver for the InvenSense
	  MPU-6050 6-axis IMU (3-axis gyroscope + 3-axis accelerometer
	  + temperature sensor).

	  This driver communicates directly over the Linux I2C subsystem.
	  It does NOT support the auxiliary/master I2C bus, SPI, or
	  magnetometer add-ons.

	  To compile as a module, choose M here.  The module will be
	  called mpu6050.
```
